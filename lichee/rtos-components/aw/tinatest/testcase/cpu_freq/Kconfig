## lichee/rtos-hal/hal/source/uart/Kconfig
```kconfig
menu "UART Devices"

config DRIVERS_UART
    bool "enable uart driver"
        default y

config HAL_TEST_UART
    bool "enable uart hal APIs test command"
	depends on DRIVERS_UART
        default n

config SUNXI_UART_SUPPORT_POLL
    bool "support poll APIs"
	depends on DRIVERS_UART
        default n

config SUNXI_UART_REGISTER_UART0
    bool "support uart0 device"
	depends on DRIVERS_UART
        default n

config SUNXI_UART_REGISTER_UART1
    bool "support uart1 device"
	depends on DRIVERS_UART
        default n

config SUNXI_UART_REGISTER_UART2
    bool "support uart2 device"
	depends on DRIVERS_UART
        default n

config SUNXI_UART_REGISTER_UART3
    bool "support uart3 device"
	depends on DRIVERS_UART
        default n

config SUNXI_UART_REGISTER_UART4
    bool "support uart4 device"
	depends on DRIVERS_UART
        default n

config SUNXI_UART_REGISTER_UART5
    bool "support uart5 device"
	depends on DRIVERS_UART
        default n

config SUNXI_UART_REGISTER_UART6
    bool "support uart6 device"
	depends on DRIVERS_UART
        default n

config SUNXI_UART_REGISTER_UART7
    bool "support uart7 device"
	depends on DRIVERS_UART
        default n

config SUNXI_UART_REGISTER_UART8
    bool "support uart8 device"
	depends on DRIVERS_UART
        default n

config SUNXI_UART_REGISTER_UART9
    bool "support uart9 device"
	depends on DRIVERS_UART
        default n

config CLI_UART_PORT
    int "cli uart port number"
    depends on DRIVERS_UART
    default 0

config UART_DMA
    bool "support transfer uart data through dma"
    depends on DRIVERS_UART
    default n
endmenu
```

## lichee/rtos/arch/risc-v/Kconfig
```kconfig
#
# For a description of the syntax of this configuration file,
# see misc/tools/kconfig-language.txt.
#

if ARCH_RISCV

comment "RISCV Options"

menu "sunxi platform"

config ARCH_SUN8IW20
	bool "allwinner sun8iw20"
	select ARCH_RISCV_C906
	default n

config ARCH_SUN20IW2
	bool "allwinner sun20iw2"
	select ARCH_RISCV_C906
	default n

config ARCH_SUN55IW3
	bool "allwinner sun55iw3"
	select ARCH_RISCV_E906
	default n

config ARCH_SUN55IW6
	bool "allwinner sun55iw6"
	select ARCH_RISCV_E907
	default n

config ARCH_SUN60IW1
	bool "allwinner sun60iw1"
	select ARCH_RISCV_E906
	default n

endmenu

config ARCH_RISCV_C906
	bool
	select ARCH_RISCV_RV64
	select LITTLE_ENDIAN

config ARCH_RISCV_E906
	bool
	select ARCH_RISCV_RV32
	select LITTLE_ENDIAN

config ARCH_RISCV_E907
	bool
	select ARCH_RISCV_RV32
	select LITTLE_ENDIAN

config ARCH_RISCV_RV64
	bool

config ARCH_RISCV_RV32
	bool

config TOOLCHAIN_CPU
	string
	default ""

choice
	prompt "Floating point ABI"
	default TOOLCHAIN_RISCV_FLOAT_SOFT

config TOOLCHAIN_RISCV_FLOAT_HARD
	bool "hardfp"
	select TOOLCHAIN_FLOAT_HARD

config TOOLCHAIN_RISCV_FLOAT_SOFTFP
	bool "softfp"
	select TOOLCHAIN_FLOAT_SOFTFP

config TOOLCHAIN_RISCV_FLOAT_SOFT
	bool "soft"
	select TOOLCHAIN_FLOAT_SOFT

config TOOLCHAIN_RISCV_FLOAT_NONE
	bool "none"
	select TOOLCHAIN_FLOAT_NONE

endchoice

config TOOLCHAIN_MACH_FLAGS
	string "toolchain arch cflags"
	default "-mcmodel=medany -mabi=lp64d -march=rv64gcxthead"

config TOOLCHAIN_LD_FLAGS
	string
	default "-melf32lriscv" if ARCH_RISCV_RV32

config TOOLCHAIN_MFPU
	string
	default ""

config TOOLCHAIN_FPU_ABI
	string
	default "-march=rv64gcxthead" if TOOLCHAIN_FLOAT_SOFT
	default "-march=rv64gcxthead" if TOOLCHAIN_FLOAT_SOFTFP
	default "-march=rv64gcxthead" if TOOLCHAIN_FLOAT_HARD
	default "" if TOOLCHAIN_FLOAT_NONE

config ARCH_RISCV_FPU
	bool "FPU support"
	default y
	---help---
		Build in support for the RISC-V Floating Point Unit (FPU).
		Check your chip specifications first; not all RISC-V chips support the FPU.

config SAVE_C906_FPU_CONTEXT_IN_TCB
	bool "Save C906 FPU context in thread TCB"
	depends on ARCH_RISCV_C906
	depends on ARCH_RISCV_FPU
	default y
	---help---
		When enable this configuration, the system will skip FPU context save/restore
		opertaion on some unnecessary situation, you'd better enable this config unless
		the FPU work abnormally after enable this config.

config RECORD_C906_FPU_CTX_STATISTICS
	bool "Record C906 FPU context save/restore statistics info for debug"
	depends on SAVE_C906_FPU_CONTEXT_IN_TCB
	default n
	---help---
		Record C906 FPU context save/restore operation(skip situation) statistics info.

config ARCH_RISCV_PMU
    bool "RISC-V PMU Support"
    default n

config ARCH_HAVE_MMU
    bool "MMU Support"
	default n

config ARCH_HAVE_DCACHE
    bool "DCache Support"
	default n

config ARCH_HAVE_ICACHE
    bool "ICache Support"
	default n

menuconfig ARCH_RISCV_PMP
	bool "RISC-V PMP Support"
	default n

if ARCH_RISCV_PMP
config PMP_EARLY_ENABLE
	bool "enable PMP early"
	default n
config PMP_REGIONS
	int "Max PMP Regions"
	default 8
config PMP_ADDR_ALIGN
	int "addr align"
	default 128 if ARCH_RISCV_E906
	default 4096 if ARCH_RISCV_C906
choice
	prompt "pmp mode"
	default PMP_USE_TOR_MODE
config PMP_USE_TOR_MODE
	bool "tor mode"
config PMP_USE_NAPOT_MODE
	bool "napot mode"
endchoice

config PMP_DEBUG_CONFIG_SEQUENCE
	bool "Debug PMP configuration sequence"
	default n
	help
	  Debug PMP configuration sequence. When this config enable, the system will
	  record the PMP configuration info, and you can get these record info to analysis
	  whether the PMP configuration sequence is correct.

config PMP_CONFIG_RECORD_NUM
	int "PMP configuration record num"
	depends on PMP_DEBUG_CONFIG_SEQUENCE
	default 16

endif

config GEN_DIGEST
	bool "genterate .digest segment"
	default n

config ARCH_TIMER_HZ
	int "Arch Timer Frequency"
	default 24000000
	help
	  This timer is used for rtos system ticking clock

endif
```

## lichee/rtos/drivers/drv/charger/Kconfig
```kconfig
menuconfig DRIVERS_CHARGER
	bool "charger drivers"
	default n

if DRIVERS_CHARGER

config BQ24725A_CHARGER
	bool "bq24725a charger driver"
	default n
	depends on DRIVERS_TWI
	depends on DRIVERS_SUNXI_GPADC
endif
```
