## lichee/rtos-components/aw/tinatest/testcase/cpu_freq/Kconfig
```kconfig
config TESTCASE_CPU_FREQ
	bool "CPU_FREQ Testcase."
	select COMPONENTS_PM
	default n

if TESTCASE_CPU_FREQ
config CPU_FREQ_LOOP_TIMES
       default "10000"
       string "loop times"
       help
               This means how many cpu_freq test times need to be tested.
               Please input the reboot times.
endif
```

## lichee/rtos-components/aw/tinatest/testcase/thermal/Kconfig
```kconfig
config TESTCASE_THERMAL
	bool "CPU_THERMAL Testcase."
	select DRIVERS_EFUSE
	select DRIVERS_GPADC
	default n

if TESTCASE_THERMAL
config THERMAL_LOOP_TIMES
       default "10000"
       string "loop times"
       help
               This means how many thermal test times need to be tested.
               Please input the reboot times.
endif
```

## lichee/rtos-components/thirdparty/bmi055/Kconfig
```kconfig
config COMPONENT_IMU_BMI055
    bool "spi imu bmi055"
    default n
    select DRIVERS_TWI
    select DRIVERS_SPI
    help
      support spi imu bmi055
```

## lichee/rtos-components/thirdparty/invensense/Kconfig
```kconfig
config COMPONENT_TDK_INVENSENSE
  bool "TDK InvenSense Sensor support"
  default n

config COMPONENT_TDK_SENSOR_ICM40608
    bool "TDK InvenSense ICM-40608 Sensor support"
    default n
    depends on COMPONENT_TDK_INVENSENSE
    select DRIVERS_SPI
```

## lichee/rtos-components/thirdparty/openamp/Kconfig
```kconfig
menu "OpenAMP Support"

config COMPONENTS_LIBMETAL
	bool "Libmetal Support"
	default n

config COMPONENTS_OPENAMP
	bool "OpenAMP Framework Support"
	depends on COMPONENTS_LIBMETAL && DRIVERS_MSGBOX
	default n

if COMPONENTS_OPENAMP
	config AMP_SLAVE_MODE
		bool "salve mode(only support slave mode)"
		default y

	config MBOX_CHANNEL
		int "Using msgbox channel"
		range 0 7
		default 0

	config MBOX_QUEUE_LENGTH
		int "Config msgbox recv queue len"
		range 1 1024
		default 16

	config VDEV_RESERVED_MEM
		bool "Virtio device reserved memory"
		depends on ARCH_RISCV_PMP && PMP_EARLY_ENABLE
		default y
		help
		  OpenAMP need to specify reserved memory for normal rpmsg communication
		  when MPU(eg: PMP hardware in RISC-V) enable and turn on early. If you
		  don't specify the reserved memory, system will possibly crash because of MPU.
		  And the parameter(address, size) of reserved memory is need to be same with
		  the peer entity of rpmsg communication.

	if VDEV_RESERVED_MEM
		config VDEV_BUF_RESERVED_MEM_ADDR
			hex "Virtio device buffer reserved memory addr"
			default 0x42400000

		config VDEV_BUF_RESERVED_MEM_SIZE
			hex "Virtio device buffer reserved memory size"
			default 0x40000

		config VDEV_VRING0_RESERVED_MEM_ADDR
			hex "Virtio device vring0 reserved memory addr"
			default 0x42440000

		config VDEV_VRING0_RESERVED_MEM_SIZE
			hex "Virtio device vring0 reserved memory size"
			default 0x2000

		config VDEV_VRING1_RESERVED_MEM_ADDR
			hex "Virtio device vring1 reserved memory addr"
			default 0x42442000

		config VDEV_VRING1_RESERVED_MEM_SIZE
			hex "Virtio device vring1 reserved memory size"
			default 0x2000
	endif # VIRTIO_DEV_RESERVED_MEM

	config RPMSG_DEMO
		bool "rpmsg simple demo"
		default n

	config RPMSG_NOTIFY
		bool "rpmsg notify driver"
		default n

	config RPMSG_SPEEDTEST
		bool "rpmsg speedtest demo"
		default n

	config RPMSG_TEST
		bool "rpmsg test demo"
		default n

	menuconfig RPMSG_CLIENT
		bool "rpmsg client driver"
		default n
	if RPMSG_CLIENT
		config RPMSG_CLIENT_TEST
			depends on COMPONENTS_MD5
			bool "Export client test cmd"
			default n
		config RPMSG_CLIENT_QUEUE_SIZE
			int "rpmsg rx queue size"
			range 0 128
			default 16
		config RPMSG_CLIENT_DEBUG
			bool "printf debug info"
			default n
	endif

	menuconfig RPMSG_HEARBEAT
		bool "rpmsg hearbeat driver"
		default n
	if RPMSG_HEARBEAT
		config RPMSG_REMOTE_NAME
		string "remoteproc master name."
		default "e907_rproc"
		help
			remoteproc master name.
			it will be defined in device tree in major core.
			e.g e907_rproc@0 { ... }; is defined in dts.
			e907_rproc is the master name.
	endif

	config SLAVE_EARLY_BOOT
		bool "system will early boot before master rproc ready"
		default n

	menuconfig AMP_TRACE_SUPPORT
		bool "openamp trace Support"
		default n
		help
		  This is a demo thar introduces how to use RPBuf to exchange large data
		  with remote processor.
	if AMP_TRACE_SUPPORT
	config AMP_TRACE_BUF_SIZE
		hex "config trace buffer size"
		default 0x1000
	endif

	menuconfig MULTI_OPENAMP_SUPPORT
		bool "multi openamp support"
		default n
	if MULTI_OPENAMP_SUPPORT
		config MULTI_OPENAMP_SUPPORT_RV
			bool "support toriscv rproc"
		if MULTI_OPENAMP_SUPPORT_RV
		choice
			prompt "support torv rproc"
		config OPENAMP_TORV_RPROC_MASTER
			bool "master"
		config OPENAMP_TORV_RPROC_SLAVE
			bool "slave"
		endchoice

		config TORV_MBOX_CHANNEL
			int "Using msgbox channel"
			range 0 7
			default 0
		config TORV_MBOX_QUEUE_LENGTH
			int "Config msgbox recv queue len"
			range 1 1024
			default 16
		endif

		config MULTI_OPENAMP_SUPPORT_DSP
			bool "support todsp rproc"
		if MULTI_OPENAMP_SUPPORT_DSP
		choice
			prompt "support todsp rproc"
		config OPENAMP_TODSP_RPROC_MASTER
			bool "master"
		config OPENAMP_TODSP_RPROC_SLAVE
			bool "slave"
		endchoice

		config TODSP_MBOX_CHANNEL
			int "Using msgbox channel"
			range 0 7
			default 0
		config TODSP_MBOX_QUEUE_LENGTH
			int "Config msgbox recv queue len"
			range 1 1024
			default 16

		endif
	endif

	config AMP_SHARE_IRQ
		bool "openamp share interrupts support"
		select COMPONENTS_OPENAMP_OPEN_AMP
		default n
		help
			Openamp share interrupts support

endif

endmenu
```

## lichee/rtos-components/thirdparty/rtt_memheap/Kconfig
```kconfig
config COMPONENT_RTT_MEMHEAP
	bool "RT-Thread heap memory manager"
	default n
	help
		This heap memory manager is extracted form RT-Thread memheap module.
		It provide similar APIs to manage memory.
```

## lichee/rtos-hal/hal/source/car_reverse/Kconfig
```kconfig
menu "FASTBOOT Devices"

config DRIVERS_FASTBOOT
	bool "enable fastboot driver"
	default n

config CAR_REVERSE_LOG_LEVEL
	int "log level"
	default 2
	range 0 8
	depends on DRIVERS_FASTBOOT

config PREVIEW_SCREEN_WIDTH
	int "display screen width"
	depends on DRIVERS_FASTBOOT
	default 1280

config PREVIEW_SCREEN_HEIGHT
	int "display screen height"
	depends on DRIVERS_FASTBOOT
	default 800

config PREVIEW_SOURCE_WIDTH
	int "display input source width"
	depends on DRIVERS_FASTBOOT
	default 1280

config PREVIEW_SOURCE_HEIGHT
	int "display input source height"
	depends on DRIVERS_FASTBOOT
	default 800
choice
	prompt "display input source format"
	default PREVIEW_SOURCE_FORMAT_YV12

config PREVIEW_SOURCE_FORMAT_NV16
	bool "Display input source format NV16"
	depends on DRIVERS_FASTBOOT

config PREVIEW_SOURCE_FORMAT_NV61
	bool "display input source format NV61"
	depends on DRIVERS_FASTBOOT

config PREVIEW_SOURCE_FORMAT_NV12
	bool "display input source format NV12"
	depends on DRIVERS_FASTBOOT

config PREVIEW_SOURCE_FORMAT_NV21
	bool "display input source format NV21"
	depends on DRIVERS_FASTBOOT

config PREVIEW_SOURCE_FORMAT_YV12
	bool "display input source format YV12"
	depends on DRIVERS_FASTBOOT

endchoice

choice
	prompt "Configure car reverse status"
	depends on DRIVERS_FASTBOOT
	default CAR_REVERSE_DEFAULT_STOP

config CAR_REVERSE_DEFAULT_START
	bool "car reverse enter start"

config CAR_REVERSE_DEFAULT_STOP
	bool "car reverse enter stop"

config FASTBOOT_VIDEO_DEFAULT_START
	bool "fastboot video start"

endchoice

config CAR_REVERSE_EXCHANGE_DISP2_PARA
	bool "support exchange disp2 para for car reverse"
	default n
	depends on DRIVERS_FASTBOOT

config EXCHANGE_DISP2_PARA_LEN
	hex "exchange disp2 para size in elf"
	depends on CAR_REVERSE_EXCHANGE_DISP2_PARA

menu "VIDEO EARLY Devices"
config DRIVERS_VIDEO_EARLY
	bool "enable video early driver"
	depends on DRIVERS_FASTBOOT
	default n

config VIDEO_EARLY_RV_DECODE_SUPPORT
	bool "rtos video decoder for video early"
	depends on DRIVERS_VIDEO_EARLY
	default n

config BUFFER_POOL_VE_MEM_ADDR
	hex "buffer addr for ve use"
	depends on DRIVERS_VIDEO_EARLY

config BUFFER_POOL_VE_MEM_LEN
	hex "buffer len for ve use"
	depends on DRIVERS_VIDEO_EARLY

config BUFFER_POOL_VE_BUFFER_CNT
	int "Number of buffers for ve use"
	depends on DRIVERS_VIDEO_EARLY
	default 5
endmenu

menu "CAR REVERSE Devices"
config DRIVERS_CAR_REVERSE
	bool "enable car reverse driver"
	depends on DRIVERS_FASTBOOT
	default n

config CAR_REVERSE_SUPPORT_TVD
	bool "support tvd input source for car reverse"
	depends on DRIVERS_CAR_REVERSE && DRIVERS_TVD
	default n

config CAR_REVERSE_SUPPORT_VIN
	bool "support vin input source for car reverse"
	depends on DRIVERS_CAR_REVERSE && DRIVERS_VIN && VIDEO_SUNXI_VIN_SPECIAL
	default n

config CAR_REVERSE_SUPPORT_AUXILIARY_LINE
	bool "support auxiliary line display"
	depends on DRIVERS_CAR_REVERSE
	default n

config CAR_REVERSE_SUPPORT_PREVIEW_ROTATOR
	bool "support g2d to rotate preview output"
	depends on DRIVERS_CAR_REVERSE
	default n

config CAR_REVERSE_SUPPORT_PREVIEW_ENHANCER
	bool "support di to enhance preview output"
	depends on DRIVERS_CAR_REVERSE
	default n

config CAR_REVERSE_SUPPORT_AMP_CRTL
	bool "support car reverse to communicate with arm"
	depends on DRIVERS_CAR_REVERSE
	default n

config BUFFER_POOL_SWAP_BUFFER_CNT
	int "Number of buffers for csi/tvd use"
	depends on DRIVERS_CAR_REVERSE
	default 3

config BUFFER_POOL_SWAP_CLEAN_BUFFER_CNT
	int "Number of buffers for di/g2d/display use"
	depends on DRIVERS_CAR_REVERSE
	default 6

config BUFFER_POOL_MEM_ADDR
	hex "buffer addr for car reverse use"
	depends on DRIVERS_CAR_REVERSE

config BUFFER_POOL_MEM_LEN
	hex "buffer len for car reverse use"
	depends on DRIVERS_CAR_REVERSE

config CAR_REVERSE_GPIO_CHECK
	bool "check gpio for car reverse"
	depends on DRIVERS_CAR_REVERSE
	default n

config CAR_REVERSE_STABILITY_TEST
	bool "stability test for car reverse"
	depends on DRIVERS_CAR_REVERSE
	default n

config CAR_REVERSE_MEMORY_LEAK_TEST
	bool "memory leak test for car reverse"
	depends on DRIVERS_CAR_REVERSE
	default n
endmenu

endmenu
```

## lichee/rtos-hal/hal/source/cir_ng/Kconfig
```kconfig
menu "SUNXI IRRX Devices"

config DRIVERS_SUNXI_IRRX
	bool "enable sunxi irrx driver"
        default n

config HAL_TEST_CIR
	bool "CIR TEST CASE"
	default n
endmenu
```

## lichee/rtos-hal/hal/source/gmac/Kconfig
```kconfig
menu "GMAC Devices"

config DRIVERS_GMAC
    bool "enable gmac driver"
    default n

endmenu
```

## lichee/rtos-hal/hal/source/gpadc-ng/Kconfig
```kconfig
menu "SUNXI GPADC Devices"

config DRIVERS_SUNXI_GPADC
    bool "enable gpadc-ng driver"
        default n

config HAL_TEST_SUNXI_GPADC
    bool "enable gpadc-ng hal APIs test command"
    depends on DRIVERS_SUNXI_GPADC
        default n

endmenu
```

## lichee/rtos-hal/hal/source/iommu/Kconfig
```kconfig
menu "IOMMU Devices"

config DRIVERS_IOMMU
    bool "enable iommu driver"
    default n

if DRIVERS_IOMMU
config DRIVERS_IOMMU_G2D
    bool "enable iommu for g2d"
    default n

config DRIVERS_IOMMU_VE
    bool "enable iommu for ve"
    default n

config DRIVERS_IOMMU_DE
    bool "enable iommu for de"
    default n

config DRIVERS_IOMMU_CSI
    bool "enable iommu for csi"
    default n

config DRIVERS_IOMMU_DI
    bool "enable iommu for di"
    default n

config HAL_TEST_IOMMU
    bool "iommu testcase"
    default n

config DRIVERS_IOMMU_KERNEL_START_ADDRESS
    hex "iommu kernel start address"
    default 0x60000000

config DRIVERS_IOMMU_KERNEL_AREA_SIZE
    hex "iommu kernel area size"
    default 0x8000000

config DRIVERS_IOMMU_DMA_START_ADDRESS
    hex "iommu dma start address"
    default 0x10000000

config DRIVERS_IOMMU_DMA_AREA_SIZE
    hex "iommu dma area size"
    default 0x8000000

endif

endmenu
```

## lichee/rtos-hal/hal/source/pwm_ng/Kconfig
```kconfig
menu "SUNXI PWM Devices"
config DRIVERS_SUNXI_PWM
    bool "enable pwm-ng driver"
        default n

config HAL_TEST_SUNXI_PWM
    bool "enable pwm-ng hal APIs test command"
    depends on DRIVERS_SUNXI_PWM
        default n

endmenu
```

## lichee/rtos-hal/hal/source/sunxi-di/Kconfig
```kconfig
menu "DE-Interlace Driver"

config DRIVERS_DI
    bool "enable di driver"
        default n

config DRIVERS_DI_V1XX
  bool "Support DI V110/120"
  depends on (DRIVERS_DI)
  default n
  ---help---
  Say Y here if you want to use DI110/120.
  Say N here if you do NOT want to use DI110/120.
  If unsure, say N.

config DRIVERS_DI_V3XX
  bool "Support DI V300"
  depends on (DRIVERS_DI)
  default n
  ---help---
  Say Y here if you want to use DI300.
  Say N here if you do NOT want to use DI300.
  If unsure, say N.

config HAL_TEST_DI
  bool "enable sunxi di test command"
  depends on (DRIVERS_DI)
  default n
  ---help---
  Say Y here if you want to test di110/120.
  Say N here if you do NOT want to test DI110/120.
  If unsure, say N.

endmenu
```

## lichee/rtos-hal/hal/source/timer/Kconfig
```kconfig
menu "TIMER Devices"

config DRIVERS_TIMER
    bool "enable timer driver"
        default y

config DRIVERS_TIMER_AVS
    bool "enable avs timer driver"
        default n

config DRIVERS_WAKEUP_TIMER
    bool "enable timer wakeup driver"
        default n

config DRIVERS_HTIMER
    bool "enable hrtimer driver"
        default n

choice
    prompt "Configure htimer clk"
	depends on DRIVERS_HTIMER
	default HTIMER_CLK_100MHZ

config HTIMER_CLK_200MHZ
    bool "200MHZ"

config HTIMER_CLK_100MHZ
    bool "100MHZ"

config HTIMER_CLK_50MHZ
    bool "50MHZ"

config HTIMER_CLK_25MHZ
    bool "25MHZ"

endchoice

config HAL_TEST_TIMER
	bool "enable timer hal APIs test command"
		depends on DRIVERS_TIMER || DRIVERS_HTIMER
		default n
endmenu
```

## lichee/rtos-hal/hal/source/timestamp/Kconfig
```kconfig
menu "TIMESTAMP Devices"

config DRIVERS_TIMESTAMP
    bool "enable timestamp driver"
        default n

config HAL_TEST_TIMESTAMP
    bool "enable timestamp hal APIs test command"
    depends on DRIVERS_TIMESTAMP
        default n

endmenu
```

## lichee/rtos-hal/hal/source/tvd/Kconfig
```kconfig
menu "TVD Devices"

config DRIVERS_TVD
    bool "enable tvd driver"
    default n

config TVD_EXCHANGE_WITH_ARM
    bool "enable tvd exchange control with arm"
    depends on DRIVERS_TVD
    default n

endmenu
```

## lichee/rtos-hal/hal/source/twi/Kconfig
```kconfig
menu "TWI Devices"

config DRIVERS_TWI
    bool "enable twi driver"
        default y

config HAL_TEST_TWI
    bool "enable twi hal APIs test command"
    depends on DRIVERS_TWI
        default n

config SUNXI_TWI_PORT
    int "use twi port"
    depends on DRIVERS_TWI
    default 0
endmenu
```
