## lichee/dsp/arch/common/configs/sun20iw1p1_d1_dsp0_defconfig
```kconfig
CONFIG_ARCH_SUN8IW20=y
# CONFIG_DRIVERS_PRCM is not set
CONFIG_SUNXI_UART_REGISTER_UART2=y
CONFIG_CLI_UART_PORT=2
CONFIG_DRIVERS_INTC=y
# CONFIG_DRIVERS_TWI is not set
CONFIG_DRIVERS_MSGBOX=y
CONFIG_DRIVERS_MSGBOX_AMP=y
# CONFIG_DRIVERS_SOUND is not set
# CONFIG_STANDBY is not set
# CONFIG_JTAG_DEBUG_DSP1 is not set
CONFIG_MEMTESTER=y
CONFIG_COMPONENTS_MALLOC=y
CONFIG_COMPONENTS_AMP=y
CONFIG_COMPONENTS_RPBUF_SERVICE_RPMSG=y
CONFIG_COMPONENTS_RPBUF_CONTROLLER=y
CONFIG_COMPONENTS_RPBUF_DEMO=y
CONFIG_COMPONENTS_XTENSA_LIBGLOSS=y
CONFIG_COMPONENTS_FREERTOS_CLI=y
CONFIG_FREERTOS_CLI_CMD_MEM_RW=y
CONFIG_FREERTOS_CLI_CMD_FREE=y
CONFIG_COMPONENTS_LIBMETAL=y
CONFIG_COMPONENTS_OPENAMP=y
CONFIG_RPMSG_CLIENT=y
CONFIG_RPMSG_CLIENT_TEST=y
CONFIG_RPMSG_CLIENT_DEBUG=y
CONFIG_AMP_TRACE_SUPPORT=y
CONFIG_CC_OPTIMIZE_FOR_PERFORMANCE_O2=y
```

## lichee/dsp/arch/common/configs/sun55iw3p1_mr527_dsp0_defconfig
```kconfig
CONFIG_ARCH_SUN55IW3=y
# CONFIG_DRIVERS_PRCM is not set
CONFIG_SUNXI_UART_REGISTER_UART8=y
CONFIG_CLI_UART_PORT=8
CONFIG_DRIVERS_INTC=y
# CONFIG_DRIVERS_TWI is not set
CONFIG_DRIVERS_MSGBOX=y
CONFIG_DRIVERS_MSGBOX_AMP=y
# CONFIG_DRIVERS_TIMER is not set
# CONFIG_DRIVERS_SOUND is not set
# CONFIG_STANDBY is not set
# CONFIG_AW_JTAG_DEBUG is not set
CONFIG_COMPONENTS_RPBUF_SERVICE_RPMSG=y
CONFIG_COMPONENTS_RPBUF_CONTROLLER=y
CONFIG_COMPONENTS_RPBUF_DEMO=y
CONFIG_MULTI_CONSOLE=y
CONFIG_UART_MULTI_CONSOLE=y
CONFIG_RPMSG_MULTI_CONSOLE=y
CONFIG_RPMSG_CONSOLE_CACHE=y
CONFIG_COMPONENTS_XTENSA_LIBGLOSS=y
CONFIG_COMPONENTS_FREERTOS_CLI=y
CONFIG_FREERTOS_CLI_CMD_MEM_RW=y
CONFIG_COMPONENTS_LIBMETAL=y
CONFIG_COMPONENTS_OPENAMP=y
CONFIG_RPMSG_CLIENT=y
CONFIG_RPMSG_HEARBEAT=y
CONFIG_RPMSG_REMOTE_NAME="dsp0_rproc"
```

## lichee/dsp/arch/common/configs/sun60iw1p1_dsp0_defconfig
```kconfig
CONFIG_ARCH_SUN60IW1=y
# CONFIG_DRIVERS_PRCM is not set
CONFIG_SUNXI_UART_REGISTER_UART0=y
CONFIG_DRIVERS_INTC=y
# CONFIG_DRIVERS_DMA is not set
# CONFIG_DRIVERS_TWI is not set
CONFIG_DRIVERS_MSGBOX=y
CONFIG_DRIVERS_MSGBOX_AMP=y
# CONFIG_DRIVERS_TIMER is not set
CONFIG_DRIVERS_HTIMER=y
# CONFIG_DRIVERS_SOUND is not set
# CONFIG_STANDBY is not set
# CONFIG_AW_JTAG_DEBUG is not set
CONFIG_COMPONENTS_XTENSA_LIBGLOSS=y
CONFIG_COMPONENTS_FREERTOS_CLI=y
CONFIG_FREERTOS_CLI_CMD_MEM_RW=y
CONFIG_COMPONENTS_LIBMETAL=y
CONFIG_COMPONENTS_OPENAMP=y
```

## lichee/dsp/arch/common/configs/sun8iw20p1_dsp0_defconfig
```kconfig
CONFIG_ARCH_SUN8IW20=y
CONFIG_DRIVER_SYSCONFIG=y
# CONFIG_DRIVERS_PRCM is not set
CONFIG_SUNXI_UART_REGISTER_UART2=y
CONFIG_CLI_UART_PORT=2
CONFIG_DRIVERS_INTC=y
CONFIG_DRIVERS_EFUSE=y
# CONFIG_DRIVERS_TWI is not set
CONFIG_DRIVERS_MSGBOX=y
CONFIG_DRIVERS_MSGBOX_AMP=y
CONFIG_SND_CODEC_SUN8IW20_AUDIOCODEC=y
CONFIG_SND_CODEC_DUMMY=y
CONFIG_COMPONENTS_AW_TINY_ALSA_LIB=y
CONFIG_COMPONENTS_AW_ALSA_UTILS=y
# CONFIG_STANDBY is not set
# CONFIG_JTAG_DEBUG_DSP1 is not set
CONFIG_MEMTESTER=y
CONFIG_COMPONENTS_MALLOC=y
CONFIG_COMPONENTS_AMP=y
CONFIG_COMPONENTS_AW_AUDIO_SYSTEM=y
CONFIG_COMPONENTS_AW_AUDIO_SYSTEM_HW=y
CONFIG_COMPONENTS_AW_AUDIO_SYSTEM_HW_PCM=y
CONFIG_COMPONENTS_AW_AUDIO_SYSTEM_TRACK=y
CONFIG_COMPONENTS_AW_AUDIO_SYSTEM_RECORD=y
CONFIG_COMPONENTS_AW_AUDIO_SYSTEM_UTILS=y
CONFIG_COMPONENTS_AW_AUDIO_SYSTEM_PLUGIN=y
CONFIG_COMPONENTS_RPBUF_SERVICE_RPMSG=y
CONFIG_COMPONENTS_RPBUF_CONTROLLER=y
CONFIG_COMPONENTS_RPBUF_DEMO=y
CONFIG_COMPONENTS_AW_SYS_CONFIG_SCRIPT=y
CONFIG_SYS_CONFIG_BUILDIN=y
CONFIG_COMPONENTS_XTENSA_LIBGLOSS=y
CONFIG_COMPONENTS_FREERTOS_CLI=y
CONFIG_FREERTOS_CLI_CMD_MEM_RW=y
CONFIG_FREERTOS_CLI_CMD_FREE=y
CONFIG_COMPONENTS_LIBMETAL=y
CONFIG_COMPONENTS_OPENAMP=y
CONFIG_RPMSG_CLIENT=y
CONFIG_RPMSG_CLIENT_TEST=y
CONFIG_RPMSG_CLIENT_DEBUG=y
CONFIG_AMP_TRACE_SUPPORT=y
CONFIG_CC_OPTIMIZE_FOR_PERFORMANCE_O2=y
```

## lichee/dsp/arch/common/configs/sun8iw20p1_t113_dsp0_defconfig
```kconfig
CONFIG_ARCH_SUN8IW20=y
CONFIG_DRIVER_SYSCONFIG=y
# CONFIG_DRIVERS_PRCM is not set
CONFIG_SUNXI_UART_REGISTER_UART2=y
CONFIG_CLI_UART_PORT=2
CONFIG_DRIVERS_INTC=y
CONFIG_HAL_TEST_DMA=y
# CONFIG_DRIVERS_TWI is not set
CONFIG_DRIVERS_MSGBOX=y
CONFIG_DRIVERS_MSGBOX_AMP=y
# CONFIG_DRIVERS_SOUND is not set
CONFIG_COMPONENTS_AW_ALSA_RPAF=y
CONFIG_COMPONENTS_AW_ALSA_RPAF_COMPONENT=y
# CONFIG_STANDBY is not set
# CONFIG_JTAG_DEBUG_DSP1 is not set
CONFIG_MEMTESTER=y
CONFIG_COMPONENTS_MALLOC=y
CONFIG_COMPONENTS_AMP=y
CONFIG_COMPONENTS_OMX_SYSTEM=y
CONFIG_COMPONENTS_OMX_BASE=y
CONFIG_COMPONENTS_OMX_BASE_FILTER=y
CONFIG_COMPONENTS_OMX_BASE_AUDIO_PORT=y
CONFIG_COMPONENTS_OMX_AUDIO_ECHO_CANCEL=y
CONFIG_COMPONENTS_OMX_AUDIO_EQUALIZER=y
CONFIG_COMPONENTS_OMX_AUDIO_UTILS=y
CONFIG_COMPONENTS_RPBUF_SERVICE_RPMSG=y
CONFIG_COMPONENTS_RPBUF_CONTROLLER=y
CONFIG_COMPONENTS_RPBUF_DEMO=y
CONFIG_MULTI_CONSOLE=y
CONFIG_UART_MULTI_CONSOLE=y
CONFIG_UART_MULTI_CONSOLE_AS_MAIN=y
CONFIG_RPMSG_MULTI_CONSOLE=y
CONFIG_RPMSG_CONSOLE_CACHE=y
CONFIG_COMPONENTS_AW_SYS_CONFIG_SCRIPT=y
CONFIG_SYS_CONFIG_BUILDIN=y
CONFIG_COMPONENTS_PROCESS_AEC=y
CONFIG_COMPONENTS_PROCESS_EQ=y
CONFIG_COMPONENTS_AW_AUDIO_AMP_AL=y
CONFIG_COMPONENTS_AW_AUDIO_RPBUF=y
CONFIG_COMPONENTS_AW_AUDIO_AMP_AL_LOG=y
CONFIG_COMPONENTS_XTENSA_LIBGLOSS=y
CONFIG_COMPONENTS_FREERTOS_CLI=y
CONFIG_FREERTOS_CLI_CMD_MEM_RW=y
CONFIG_FREERTOS_CLI_CMD_FREE=y
CONFIG_COMPONENTS_LIBMETAL=y
CONFIG_COMPONENTS_OPENAMP=y
CONFIG_RPMSG_CLIENT=y
CONFIG_RPMSG_CLIENT_TEST=y
CONFIG_RPMSG_CLIENT_DEBUG=y
CONFIG_AMP_TRACE_SUPPORT=y
CONFIG_CC_OPTIMIZE_FOR_PERFORMANCE_O2=y
```

## lichee/dsp/arch/common/configs/sun8iw20p1_t113_s3p_dsp0_defconfig
```kconfig
CONFIG_ARCH_SUN8IW20=y
CONFIG_DRIVER_SYSCONFIG=y
# CONFIG_DRIVERS_PRCM is not set
CONFIG_SUNXI_UART_REGISTER_UART0=y
CONFIG_DRIVERS_INTC=y
CONFIG_DRIVERS_EFUSE=y
# CONFIG_DRIVERS_TWI is not set
CONFIG_DRIVERS_MSGBOX=y
CONFIG_DRIVERS_MSGBOX_AMP=y
# CONFIG_DRIVERS_SOUND is not set
# CONFIG_STANDBY is not set
# CONFIG_JTAG_DEBUG_DSP1 is not set
CONFIG_COMPONENTS_AMP=y
CONFIG_COMPONENTS_RPBUF_SERVICE_RPMSG=y
CONFIG_COMPONENTS_RPBUF_CONTROLLER=y
CONFIG_COMPONENTS_RPBUF_DEMO=y
CONFIG_MULTI_CONSOLE=y
CONFIG_UART_MULTI_CONSOLE=y
CONFIG_RPMSG_MULTI_CONSOLE=y
CONFIG_RPMSG_CONSOLE_CACHE=y
CONFIG_COMPONENTS_AW_SYS_CONFIG_SCRIPT=y
CONFIG_SYS_CONFIG_BUILDIN=y
CONFIG_COMPONENTS_CEDARSE=y
CONFIG_COMPONENTS_XTENSA_LIBGLOSS=y
CONFIG_COMPONENTS_FREERTOS_CLI=y
CONFIG_FREERTOS_CLI_CMD_MEM_RW=y
CONFIG_FREERTOS_CLI_CMD_FREE=y
CONFIG_COMPONENTS_LIBMETAL=y
CONFIG_COMPONENTS_OPENAMP=y
CONFIG_RPMSG_CLIENT=y
CONFIG_RPMSG_CLIENT_DEBUG=y
CONFIG_RPMSG_HEARBEAT=y
```

## lichee/dsp/arch/common/configs/sun8iw20p1_t113s2_dsp0_defconfig
```kconfig
CONFIG_ARCH_SUN8IW20=y
CONFIG_DRIVER_SYSCONFIG=y
CONFIG_DRIVER_BOOT_DTS=y
CONFIG_SUNXI_UART_REGISTER_UART2=y
CONFIG_CLI_UART_PORT=2
# CONFIG_DRIVERS_PRCM is not set
CONFIG_DRIVERS_INTC=y
CONFIG_HAL_TEST_DMA=y
# CONFIG_DRIVERS_TWI is not set
CONFIG_DRIVERS_MSGBOX=y
CONFIG_DRIVERS_MSGBOX_AMP=y
# CONFIG_DRIVERS_SOUND is not set
CONFIG_COMPONENTS_AW_ALSA_RPAF=y
CONFIG_COMPONENTS_AW_ALSA_RPAF_COMPONENT=y
# CONFIG_STANDBY is not set
# CONFIG_JTAG_DEBUG_DSP1 is not set
CONFIG_MEMTESTER=y
CONFIG_AW_PERF_MEM_ACC=y
CONFIG_COMPONENTS_XTENSA_LIBGLOSS=y
CONFIG_COMPONENTS_FREERTOS_CLI=y
# CONFIG_FREERTOS_CLI_CMD_TEMPLATE is not set
CONFIG_FREERTOS_CLI_CMD_MEM_RW=y
CONFIG_FREERTOS_CLI_CMD_FREE=y
CONFIG_COMPONENTS_ALGO_GENERATE=y
```

## lichee/rtos-components/aw/audio_amp_al/Kconfig
```kconfig
menu "audio amp Adaptation Layer"

config COMPONENTS_AW_AUDIO_AMP_AL
	bool "AW audio amp Adaptation Layer Support"
	default n
	help
	  Support Allwinner audio amp Adaptation Layer.


source "components/common/aw/audio_amp_al/audio_process/Kconfig"
source "components/common/aw/audio_amp_al/rpbuf/Kconfig"
source "components/common/aw/audio_amp_al/rpdata/Kconfig"
source "components/common/aw/audio_amp_al/log/Kconfig"

endmenu
```

## lichee/rtos-components/aw/audio_amp_al/audio_process/Kconfig
```kconfig
menu "audio process"

config COMPONENTS_AW_AUDIO_PROCESS
	bool "Audio Process Support"
	default n
	help
		This is a interface for audio process.

config COMPONENTS_AW_AUDIO_AEC
	bool "Audio AEC Support"
	depends on COMPONENTS_AW_AUDIO_PROCESS
	help
		This is a demo that introduces how to use openmax for aec.

config COMPONENTS_AW_AUDIO_AEC_DOWNLINK
	bool "Audio AEC DOWNLINK Support"
	depends on COMPONENTS_AW_AUDIO_PROCESS
	help
		This is a demo that introduces how to use openmax for aec downlink.

config COMPONENTS_AW_AUDIO_EQ
	bool "Audio EQ Support"
	depends on COMPONENTS_AW_AUDIO_PROCESS
	help
		This is a demo that introduces how to use openmax for eq.

config COMPONENTS_AW_AUDIO_ASR
	bool "Audio ASR Support"
	depends on COMPONENTS_AW_AUDIO_PROCESS
	help
		This is a demo that introduces how to use openmax for asr.

config COMPONENTS_AW_AUDIO_MODULE_PROCESS
	bool "Audio Module Process"
	depends on COMPONENTS_AW_AUDIO_PROCESS
	help
		This is a demo that introduces how to use audio module process.

source "components/common/aw/audio_amp_al/audio_process/aec/Kconfig"
source "components/common/aw/audio_amp_al/audio_process/asr/Kconfig"
source "components/common/aw/audio_amp_al/audio_process/eq/Kconfig"
source "components/common/aw/audio_amp_al/audio_process/module_process/Kconfig"

endmenu
```

## lichee/rtos-components/aw/audio_amp_al/audio_process/aec/Kconfig
```kconfig
menu "aec process"

config COMPONENTS_AW_AUDIO_RPBUF_AEC
	bool "Audio Rpbuf AEC Support"
	depends on COMPONENTS_AW_AUDIO_AEC && COMPONENTS_RPBUF
	help
		This is a demo that introduces how to use rpbuf interface for aec.

config COMPONENTS_AW_AUDIO_RPBUF_OMX_AEC
	bool "Audio Rpbuf AEC OMX Support"
	depends on COMPONENTS_AW_AUDIO_RPBUF_AEC && COMPONENTS_OMX_SYSTEM
	help
		This is a demo that introduces how to use rpbuf and omx interface for aec.

config COMPONENTS_AW_AUDIO_RPBUF_AEC_DOWNLINK
	bool "Audio Rpbuf AEC DOWNLINK Support"
	depends on COMPONENTS_AW_AUDIO_AEC_DOWNLINK && COMPONENTS_RPBUF
	help
		This is a demo that introduces how to use rpbuf interface for aec downlink.

config COMPONENTS_AW_AUDIO_RPBUF_OMX_AEC_DOWNLINK
	bool "Audio Rpbuf AEC DOWNLINK OMX Support"
	depends on COMPONENTS_AW_AUDIO_RPBUF_AEC_DOWNLINK && COMPONENTS_OMX_SYSTEM
	help
		This is a demo that introduces how to use rpbuf and omx interface for aec.

config COMPONENTS_AW_AUDIO_RPDATA_AEC
	bool "Audio RpDATA AEC Support"
	depends on COMPONENTS_AW_AUDIO_AEC && COMPONENTS_RPDATA
	help
		This is a demo that introduces how to use rpdata interface for aec.

config COMPONENTS_AW_AUDIO_RPDATA_OMX_AEC
	bool "Audio RpDATA AEC OMX Support"
	depends on COMPONENTS_AW_AUDIO_RPDATA_AEC && COMPONENTS_OMX_SYSTEM
	help
		This is a demo that introduces how to use rpdata and omx interface for aec.

endmenu
```

## lichee/rtos-components/aw/audio_amp_al/audio_process/asr/Kconfig
```kconfig
menu "asr process"

config COMPONENTS_AW_AUDIO_RPBUF_ASR
	bool "Audio Rpbuf ASR Support"
	depends on COMPONENTS_AW_AUDIO_ASR && COMPONENTS_RPBUF
	help
		This is a demo that introduces how to use rpbuf interface for asr.

config COMPONENTS_AW_AUDIO_RPBUF_OMX_ASR
	bool "Audio Rpbuf ASR OMX Support"
	depends on COMPONENTS_AW_AUDIO_RPBUF_ASR && COMPONENTS_OMX_SYSTEM
	help
		This is a demo that introduces how to use rpbuf and omx interface for asr.

config COMPONENTS_AW_AUDIO_RPDATA_ASR
	bool "Audio RpDATA ASR Support"
	depends on COMPONENTS_AW_AUDIO_ASR && COMPONENTS_RPDATA
	help
		This is a demo that introduces how to use rpdata interface for asr.

config COMPONENTS_AW_AUDIO_RPDATA_OMX_ASR
	bool "Audio RpDATA ASR OMX Support"
	depends on COMPONENTS_AW_AUDIO_RPDATA_ASR && COMPONENTS_OMX_SYSTEM
	help
		This is a demo that introduces how to use rpdata and omx interface for asr.

endmenu
```

## lichee/rtos-components/aw/audio_amp_al/audio_process/eq/Kconfig
```kconfig
menu "eq process"

config COMPONENTS_AW_AUDIO_RPBUF_EQ
	bool "Audio Rpbuf EQ Support"
	depends on COMPONENTS_AW_AUDIO_EQ && COMPONENTS_RPBUF
	help
		This is a demo that introduces how to use rpbuf interface for eq.

config COMPONENTS_AW_AUDIO_RPBUF_OMX_EQ
	bool "Audio Rpbuf EQ OMX Support"
	depends on COMPONENTS_AW_AUDIO_RPBUF_EQ && COMPONENTS_OMX_SYSTEM
	help
		This is a demo that introduces how to use rpbuf and omx interface for eq.

config COMPONENTS_AW_AUDIO_RPDATA_EQ
	bool "Audio RpDATA EQ Support"
	depends on COMPONENTS_AW_AUDIO_EQ && COMPONENTS_RPDATA
	help
		This is a demo that introduces how to use rpdata interface for eq.

config COMPONENTS_AW_AUDIO_RPDATA_OMX_EQ
	bool "Audio RpDATA EQ OMX Support"
	depends on COMPONENTS_AW_AUDIO_RPDATA_EQ && COMPONENTS_OMX_SYSTEM
	help
		This is a demo that introduces how to use rpdata and omx interface for eq.

endmenu
```

## lichee/rtos-components/aw/audio_amp_al/audio_process/module_process/Kconfig
```kconfig
menu "module process"

config COMPONENTS_AW_AUDIO_RPBUF_MODULE_PROCESS
	bool "Audio Rpbuf MODULE_PROCESS Support"
	depends on COMPONENTS_AW_AUDIO_MODULE_PROCESS && COMPONENTS_RPBUF
	help
		This is a demo that introduces how to use rpbuf interface for module process.

config COMPONENTS_AW_AUDIO_RPBUF_OMX_MODULE_PROCESS
	bool "Audio Rpbuf MODULE_PROCESS OMX Support"
	depends on COMPONENTS_AW_AUDIO_RPBUF_MODULE_PROCESS && COMPONENTS_OMX_SYSTEM
	help
		This is a demo that introduces how to use rpbuf and omx interface for module process.

config COMPONENTS_AW_AUDIO_RPDATA_MODULE_PROCESS
	bool "Audio RpDATA MODULE_PROCESS Support"
	depends on COMPONENTS_AW_AUDIO_MODULE_PROCESS && COMPONENTS_RPDATA
	help
		This is a demo that introduces how to use rpdata interface for module process.

config COMPONENTS_AW_AUDIO_RPDATA_OMX_MODULE_PROCESS
	bool "Audio RpDATA MODULE_PROCESS OMX Support"
	depends on COMPONENTS_AW_AUDIO_RPDATA_MODULE_PROCESS && COMPONENTS_OMX_SYSTEM
	help
		This is a demo that introduces how to use rpdata and omx interface for module process.

endmenu
```

## lichee/rtos-components/aw/audio_amp_al/log/Kconfig
```kconfig
menu "audio amp log"

config COMPONENTS_AW_AUDIO_AMP_AL_LOG
	bool "AW audio amp Adaptation Layer Log Support"
	default n
	help
		Support Allwinner audio amp Adaptation Layer Log.

endmenu
```

## lichee/rtos-components/aw/audio_amp_al/rpbuf/Kconfig
```kconfig
menu "rpbuf audio"

config COMPONENTS_AW_AUDIO_RPBUF
	bool "Audio Amp Rpbuf Support"
	depends on COMPONENTS_AW_AUDIO_AMP_AL && COMPONENTS_RPBUF
	default n
	help
		This is a amp rpbuf interface for audio.

menu "rpbuf audio utils"
config COMPONENTS_AW_AUDIO_RPBUF_UTILS
	bool "Audio Amp Rpbuf utils Support"
	depends on COMPONENTS_AW_AUDIO_RPBUF
	help
		This is a demo that introduces how to use rpbuf with audio in dsp.


source "components/common/aw/audio_amp_al/rpbuf/utils/Kconfig"
endmenu

endmenu
```
