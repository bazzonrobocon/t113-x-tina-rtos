## lichee/rtos-components/aw/audio_amp_al/rpbuf/utils/Kconfig
```kconfig
menu "rpbuf audio ctrl aec "
config COMPONENTS_AW_RPBUF_AUDIO_CTRL_AEC
	bool "Audio Rpbuf Ctrl aec Support"
	depends on COMPONENTS_AW_AUDIO_RPBUF_UTILS && (COMPONENTS_AW_AUDIO_AEC || COMPONENTS_AW_AUDIO_AEC_DOWNLINK)
	default n
	help
		This is a rpbuf audio ctrl for aec.

	config COMPONENTS_RPBUF_CRTL_AEC_CNT
	int "Audio Rpbuf Ctrl Aec count Support"
	depends on COMPONENTS_AW_RPBUF_AUDIO_CTRL_AEC
	default 1
	help
		This is a intger for rpbuf audio ctrl aec.

endmenu

menu "rpbuf audio ctrl eq"
config COMPONENTS_AW_RPBUF_AUDIO_CTRL_EQ
	bool "Audio Rpbuf Ctrl eq Support"
	depends on COMPONENTS_AW_AUDIO_RPBUF_UTILS && COMPONENTS_AW_AUDIO_EQ
	default n
	help
		This is a rpbuf audio ctrl for eq.

config COMPONENTS_RPBUF_CRTL_EQ_CNT
	int "Audio Rpbuf Ctrl Eq count Support"
	depends on COMPONENTS_AW_RPBUF_AUDIO_CTRL_EQ
	default 1
	help
		This is a intger for rpbuf audio ctrl eq.

endmenu

menu "rpbuf audio ctrl module process"
config COMPONENTS_AW_RPBUF_AUDIO_CTRL_MODULE_PROCESS
	bool "Audio Rpbuf Ctrl module process Support"
	depends on COMPONENTS_AW_AUDIO_RPBUF_UTILS && COMPONENTS_AW_AUDIO_MODULE_PROCESS
	default n
	help
		This is a rpbuf audio ctrl for eq.

config COMPONENTS_RPBUF_CRTL_MODULE_PROCESS_CNT
	int "Audio Rpbuf Ctrl module process count Support"
	depends on COMPONENTS_AW_RPBUF_AUDIO_CTRL_MODULE_PROCESS
	default 1
	help
		This is a intger for rpbuf audio ctrl module process.

endmenu
```

## lichee/rtos-components/aw/audio_amp_al/rpdata/Kconfig
```kconfig
menu "rpdata audio"

config COMPONENTS_AW_AUDIO_RPDATA
	bool "Audio Amp Rpdata Support"
	depends on COMPONENTS_AW_AUDIO_AMP_AL && COMPONENTS_RPDATA
	default n
	help
		This is a amp rpdata interface for audio.

menu "rpdata audio utils"

config COMPONENTS_AW_AUDIO_RPDATA_UTILS
	bool "Audio Amp Rpdata utils Support"
	depends on COMPONENTS_AW_AUDIO_RPDATA
	help
		This is a demo that introduces how to use rpdata with audio in dsp.

source "components/common/aw/audio_amp_al/rpdata/utils/Kconfig"

endmenu

endmenu
```

## lichee/rtos-components/aw/audio_amp_al/rpdata/utils/Kconfig
```kconfig
menu "rpbuf audio ctrl asr "
config COMPONENTS_AW_RPDATA_AUDIO_CTRL_ASR
	bool "Audio Rpdata Ctrl asr Support"
	depends on COMPONENTS_AW_AUDIO_RPDATA_UTILS && COMPONENTS_AW_AUDIO_ASR
	default n
	help
		This is a rpdata audio ctrl for asr.

	config COMPONENTS_RPDATA_CRTL_ASR_CNT
	int "Audio Rpbuf Ctrl Asr count Support"
	depends on COMPONENTS_AW_RPDATA_AUDIO_CTRL_ASR
	default 1
	help
		This is a intger for rpdata audio ctrl asr.

endmenu
```

## lichee/rtos-components/aw/cedarSE/Kconfig
```kconfig
config COMPONENTS_CEDARSE
	bool "AW CedarSE Support"
	default n
	help
	  Select Y to support cedarSE.
```

## lichee/rtos-components/aw/real_time_performance/Kconfig
```kconfig
menu "Real Time Performance Test"

config COMPONENTS_REAL_TIME_PERFORMANCE
	bool "AW Real Time Performance Test"
	depends on DRIVERS_HTIMER
	default n
	help
	  Support Real Time Performance Test.

config COMPONENTS_SCHEDULER_JITTER_TEST
	bool "AW Scheduler Jitter Test Support"
	depends on COMPONENTS_REAL_TIME_PERFORMANCE
	default n
	help
	  Support Allwinner Scheduler Jitter Test Support.

config COMPONENTS_INTERRUPT_JITTER_TEST
	bool "AW Interrupt Jitter Test Support"
	depends on COMPONENTS_REAL_TIME_PERFORMANCE
	default n
	help
	  Support Allwinner Interrupt Jitter Test Support.

config COMPONENTS_OPENAMP_JITTER_TEST
	bool "AW Openamp Jitter Test Support"
	depends on COMPONENTS_REAL_TIME_PERFORMANCE
	default n
	help
	  Support Allwinner Openamp Jitter Test Support.

endmenu
```

## lichee/rtos-components/aw/robot/Kconfig
```kconfig
config COMPONENTS_AW_ROBOT
    bool "Robot Test"
    select COMPONENT_CLI
    select DRIVERS_SUNXI_PWM
    select DRIVERS_HTIMER
    select DRIVERS_SUNXI_GPADC
    default n
    help
        Allwiner robot test
```

## lichee/rtos-components/aw/rpbuf/Kconfig
```kconfig
menu "RPBuf framework"

config COMPONENTS_RPBUF
	bool
	help
	  The RPBuf (Remote Processor Buffer) framework provides mechanisms to
	  allocate buffers and transmit their references to remote processor.
	  This allows user to exchange large data with remote processor.

menuconfig COMPONENTS_RPBUF_MEASURE_TIME
	bool "Rpbuf measure transmit time"
	default n
	select COMPONENTS_RPBUF
	help
	  It will take up part of buffer record sending time

if COMPONENTS_RPBUF_MEASURE_TIME
config COMPONENTS_RPBUF_MEASURE_TIMER_BASE
	hex "measurement timer regiser base address"
	default 0
config COMPONENTS_RPBUF_DUMP_TIME_INFO
	bool "dump buf transmit time"
	default n
endif # COMPONENTS_RPBUF_MEASURE_TIME

config COMPONENTS_RPBUF_SERVICE_RPMSG
	bool "RPMsg-based RPBuf service component"
	select COMPONENTS_RPBUF
	select COMPONENTS_OPENAMP_OPEN_AMP
	default n
	help
	  Say y here to enable support for the RPMsg-based RPBuf service component.
	  This is one kind of RPBuf service backend implemented with RPMsg.

config COMPONENTS_RPBUF_CONTROLLER
	bool "RPBuf controller component"
	select COMPONENTS_RPBUF
	default n
	help
	  Say y here to enable support for the RPBuf controller component.

config COMPONENTS_RPBUF_RESERVED_MEM
	bool "RPBuf reserved memory"
	depends on COMPONENTS_RPBUF && ARCH_RISCV_PMP
	default y
	help
	  RPBuf module need to specify reserved memory for buffer allocation
	  when MPU(eg: PMP hardware in RISC-V) enable. If you don't specify
	  the reserved memory, RPBuf master will use buffer with random address
	  from memory allocator. In this situation, system will possibly crash
	  because of MPU when it send data to remote processor by rpbuf.

if COMPONENTS_RPBUF_RESERVED_MEM
config COMPONENTS_RPBUF_RESERVED_MEM_ADDR
	hex "RPBuf reserved memory addr"
	default 0x42380000
	help
	  We need provide the rpbuf reserved memeory address if MPU(eg: PMP hardware in RISC-V)
	  enable. This config is need to be same with the peer entity of rpbuf communication.

config COMPONENTS_RPBUF_RESERVED_MEM_SIZE
	hex "RPBuf reserved memory size"
	default 0x80000
	help
	  We need provide the rpbuf reserved memeory size if MPU(eg: PMP hardware in RISC-V)
	  enable. This config is need to be same with the peer entity of rpbuf communication.

endif # COMPONENTS_RPBUF_RESERVED_MEM

config COMPONENTS_RPBUF_DEMO
	bool "RPBuf Demo"
	depends on COMPONENTS_MD5
	select COMPONENTS_RPBUF
	default n

endmenu
```

## lichee/rtos-components/aw/test_cpufreq/Kconfig
```kconfig
if ARCH_SUN20IW2 || ARCH_SUN55IW3

menu "Test cpufreq Component Support"

config COMPONENTS_TEST_CPUFREQ
    bool "cpufreq API test commands"
    default n

endmenu

endif
```

## lichee/rtos-components/aw/tinatest/testcase/bt/Kconfig
```kconfig
config TESTCASE_BTON
	bool "bt on Testcase."
	default n

config TESTCASE_BTOFF
	bool "bt off Testcase."
	default n

config TESTCASE_BTSCAN
	bool "bt scan Testcase."
	default n
```

## lichee/rtos-components/aw/tinatest/testcase/cpu_calc/Kconfig
```kconfig
config TESTCASE_CPU_CALC
	bool "CPU_CALC Testcase."
	select COMPONENT_DHRYSTONE
	select COMPONENT_COREMARK
	default n

if TESTCASE_CPU_CALC
config LOOP_TIMES
       default "1000000"
       string "loop times"
       help
               This means how many cpu_calc test times need to be tested.
               Please input the reboot times.
endif
```
